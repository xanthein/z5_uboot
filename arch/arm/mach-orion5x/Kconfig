## arch/arm/mach-orion5x/Kconfig
```kconfig
if ORION5X

choice
	prompt "Marvell Orion board select"
	optional

config TARGET_EDMINIV2
	bool "LaCie Ethernet Disk mini V2"
	select SUPPORT_SPL

config TARGET_Z5
	bool "Z5"

endchoice

config SYS_SOC
	default "orion5x"

source "board/LaCie/edminiv2/Kconfig"
source "board/wistron/z5/Kconfig"

config SPL_LDSCRIPT
	default "$(CPUDIR)/orion5x/u-boot-spl.lds" if ORION5X

endif
```

## board/wistron/z5/Kconfig
```kconfig
if TARGET_Z5

config SYS_BOARD
	default "z5"

config SYS_VENDOR
	default "wistron"

config SYS_CONFIG_NAME
	default "z5"

endif
```

## configs/z5_defconfig
```kconfig
CONFIG_ARM=y
CONFIG_ORION5X=y
CONFIG_SPL_LIBCOMMON_SUPPORT=y
CONFIG_SPL_LIBGENERIC_SUPPORT=y
CONFIG_TARGET_Z5=y
CONFIG_SPL_SERIAL_SUPPORT=y
CONFIG_IDENT_STRING=" Z5"
CONFIG_BOOTDELAY=3
CONFIG_MTD_NOR_FLASH=y
CONFIG_ARCH_MISC_INIT=y
CONFIG_SPL=y
CONFIG_SPL_BOARD_INIT=y
CONFIG_SPL_NOR_SUPPORT=y
CONFIG_HUSH_PARSER=y
CONFIG_SYS_PROMPT="Z5> "
# CONFIG_CMD_NET is not set
```
